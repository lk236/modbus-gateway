/*
 * bsp_ds3231.c — DS3231 RTC 实时时钟驱动
 * ============================================================================
 * 【这是什么芯片】
 *   DS3231 是 Maxim 的高精度 I2C 实时时钟 (RTC)。带温度补偿晶振 (TCXO),
 *   常温下精度约 ±2ppm(一年误差几十秒), 还内置纽扣电池切换电路:
 *   主电源断了它能靠纽扣电池继续走时, 所以"断电不丢时间"。
 *
 *   挂在本项目的 I2C1 总线上: SCL=PB6, SDA=PB7, 7 位地址 0x68
 *   (头文件里的 DS3231_I2C_ADDR = 0xD0 是"左移一位后的 8 位形式", HAL 的
 *    Mem 接口用 8 位形式, 所以直接传 0xD0)。
 *
 * 【它在本项目里的作用】
 *   给 Flash 日志提供"真实世界的时间戳"。没有它, 日志只有开机秒数,
 *   上位机看到的就是"开机后 3600 秒有条故障", 查不了"哪天几点出的问题"。
 *
 * 【本文件的一个关键坑: BCD 码】
 *   DS3231 内部的时间寄存器不是二进制, 而是 BCD 码 (Binary-Coded Decimal):
 *   一个字节存两位十进制数字, 高 4 位存十位, 低 4 位存个位。
 *   例如"25 秒"存成 0x25 (而不是十进制的 25), "59 分"存成 0x59。
 *   所以每次读写都要转换, 这就是 bcd_to_bin / bin_to_bcd 的作用。
 *
 * 【寄存器地址表】(从 0x00 开始连续 7 个字节刚好是一组完整时间)
 *   0x00 秒 / 0x01 分 / 0x02 时 / 0x03 星期 / 0x04 日 / 0x05 月 / 0x06 年
 * ============================================================================
 */
#include "bsp_ds3231.h"
#include "i2c.h"
#include <stdio.h>

/* ---- DS3231 寄存器地址 ---- */
#define DS3231_REG_SECONDS     0x00    /* 秒 (BIT7=CH 时钟暂停位) */
#define DS3231_REG_MINUTES     0x01    /* 分 (BIT7 恒为 0) */
#define DS3231_REG_HOURS       0x02    /* 时 (BIT6=12/24 模式, BIT5=12 小时制下的 PM) */
#define DS3231_REG_DAY         0x03    /* 星期 (1~7, 芯片自己维护, 本驱动只当占位) */
#define DS3231_REG_DATE        0x04    /* 日 (BIT7/BIT6 为世纪位相关, 平时当 0) */
#define DS3231_REG_MONTH       0x05    /* 月 (BIT7=世纪, BIT4 为 10 月位) */
#define DS3231_REG_YEAR        0x06    /* 年 (00~99, 表示 2000~2099) */
#define DS3231_REG_CONTROL     0x0E    /* 控制寄存器 (本驱动只读不写) */
#define DS3231_REG_STATUS      0x0F    /* 状态寄存器 (BIT7=OSF 振荡器停振标志) */

/* I2C 操作超时 (毫秒)。I2C 正常一次读写是几百微秒级, 200ms 足够宽松 */
#define DS3231_I2C_TIMEOUT     200

/* ---------------------------------------------------------------------------
 * BCD → 二进制
 *
 * BCD 字节 0xAB 表示十进制的 "AB" (A=十位, B=个位)。
 *   (bcd >> 4) 取出高 4 位 = 十位数字, 乘 10
 *   (bcd & 0x0F) 取出低 4 位 = 个位数字
 * 例: 0x25 → (0x2)*10 + 5 = 25。
 * --------------------------------------------------------------------------- */
static uint8_t bcd_to_bin(uint8_t bcd)
{
    return (bcd >> 4) * 10 + (bcd & 0x0F);
}

/* ---------------------------------------------------------------------------
 * 二进制 → BCD (bcd_to_bin 的逆运算)
 *
 *   bin/10 得到十位数字, 左移 4 位放到高半字节;
 *   bin%10 得到个位数字, 放低半字节。
 * 例: 25 → ((25/10)<<4) | (25%10) = 0x20 | 0x05 = 0x25。
 * --------------------------------------------------------------------------- */
static uint8_t bin_to_bcd(uint8_t bin)
{
    return ((bin / 10) << 4) | (bin % 10);
}

/* ---------------------------------------------------------------------------
 * 判断闰年
 *
 * 规则(格里高利历): 能被 4 整除 且 (不能被 100 整除 或 能被 400 整除)。
 *   2024 是闰年(能被4整除, 又非百年);
 *   1900 不是闰年(能被100整除, 又不能被400整除);
 *   2000 是闰年(能被400整除)。
 * 返回值: 非 0 表示闰年
 * --------------------------------------------------------------------------- */
static uint8_t is_leap(uint16_t year)
{
    return (year % 4 == 0 && year % 100 != 0) || (year % 400 == 0);
}

/* ---------------------------------------------------------------------------
 * 返回某年某月有多少天
 *
 * 用查表处理 1~12 月, 只有 2 月需要特殊判断(闰年 29 天, 平年 28 天)。
 * 注意 table[month-1]: 因为月份是 1~12, 数组下标是 0~11, 要减 1。
 * --------------------------------------------------------------------------- */
static uint8_t days_in_month(uint8_t month, uint16_t year)
{
    static const uint8_t table[] = {31, 28, 31, 30, 31, 30, 31, 31, 30, 31, 30, 31};
    if (month == 2 && is_leap(year)) return 29;   /* 闰年 2 月 29 天 */
    return table[month - 1];                      /* 其余查表 */
}

/* ---------------------------------------------------------------------------
 * 日期时间 → Unix 时间戳 (自 1970-01-01 00:00:00 UTC 起的秒数)
 *
 * 这只是个"手工日历换算", 思路是把时间全部折算成"天数", 再乘 86400 加秒数:
 *   1) 从 1970 年逐年到目标年, 累加每年的天数 (闰年 366, 平年 365)
 *   2) 从 1 月逐月到目标月, 累加每月天数
 *   3) 加上 "日", 减 1 是因为 1 号当天还没过完整的 1 天(第 1 天要从 0 开始算)
 *   4) 天数 × 86400 + 时 × 3600 + 分 × 60 + 秒
 *
 * 注意: DS3231 存的是"年份后两位", 所以这里按 2000 年世纪还原 (2000 + year)。
 *       本项目只用 2000~2099, 够用; 真要跨世纪得看月寄存器的世纪位。
 *
 * 参数 dt: 输入日期时间 (year 字段是"距 2000 年的年数")
 * 返回值: Unix 时间戳 (32 位, 注意 2038 年会溢出, 本项目寿命内无问题)
 * --------------------------------------------------------------------------- */
static uint32_t datetime_to_unix(const DS3231_DateTime *dt)
{
    uint16_t year = 2000 + dt->year;   /* 补全成完整年份 */
    uint32_t days = 0;                 /* 距 1970-01-01 的天数 */

    /* 1) 累加整年 */
    for (uint16_t y = 1970; y < year; y++) {
        days += is_leap(y) ? 366 : 365;
    }

    /* 2) 累加整月 (今年内的) */
    for (uint8_t m = 1; m < dt->month; m++) {
        days += days_in_month(m, year);
    }

    /* 3) 加上当月的天数 (减 1: 1 号是第 0 天) */
    days += dt->date - 1;

    /* 4) 换算成秒。注意乘数要用 UL(无符号长整型), 否则 32 位乘法会溢出 */
    return days * 86400UL + (uint32_t)dt->hour * 3600UL +
           (uint32_t)dt->minute * 60 + dt->second;
}

/* ---------------------------------------------------------------------------
 * Unix 时间戳 → 日期时间 (上面函数的逆运算)
 *
 * 思路: 先把总秒数逐级"除以"单位, 拆出 时/分/秒, 剩下的是"天数";
 *       再从 1970 年开始, 逐年减去一整年的天数, 剩下的年就是目标年;
 *       再逐月减去整月天数, 剩下的就是"日"。
 *
 * 这是"除法取余 + 逐步剥离"的经典写法, 和把一堆零钱换成大额面值是同一个道理。
 *
 * 参数 ts: 输入 Unix 时间戳
 * 参数 dt: 输出日期时间
 * --------------------------------------------------------------------------- */
static void unix_to_datetime(uint32_t ts, DS3231_DateTime *dt)
{
    uint32_t seconds = ts;                     /* 从秒开始逐级剥离 */

    dt->second = seconds % 60;                 /* 秒 = 总秒数对 60 取余 */
    seconds /= 60;                             /* 去掉"秒"这一级, 剩分钟数 */
    dt->minute = seconds % 60;                 /* 分 */
    seconds /= 60;                             /* 去掉"分", 剩小时数 */
    dt->hour = seconds % 24;                   /* 时 */
    uint32_t days = seconds / 24;              /* 剩下的就是天数 */

    /* 逐年剥离: 只要剩余天数 >= 一整年, 就减掉它并前进一年 */
    uint16_t year = 1970;
    while (days >= (is_leap(year) ? 366UL : 365UL)) {
        days -= is_leap(year) ? 366 : 365;
        year++;
    }
    dt->year = year - 2000;                    /* 转成 DS3231 的"年后两位" */

    /* 逐月剥离: 只要剩余天数 >= 一整月, 就减掉它并前进一月。
     * 循环结束时 days 就是"本月第几天(从0开始)", 所以下面要 +1 */
    uint8_t month = 1;
    while (days >= days_in_month(month, year)) {
        days -= days_in_month(month, year);
        month++;
    }
    dt->month = month;
    dt->date = days + 1;                       /* 1 号 = 0 天, 补 1 */
    dt->weekday = 1;                           /* 星期由芯片自己算, 这里给个占位值 */
}

/* ---------------------------------------------------------------------------
 * I2C 读 DS3231 内部寄存器
 *
 * HAL_I2C_Mem_Read 做的事情:
 *   起始 → 发从机地址(写) → 发寄存器地址(1 字节) → 重复起始 → 发从机地址(读) → 读 len 字节 → 停止
 * 这是 I2C 器件"寄存器型"读写的标准时序, HAL 帮我们封装好了。
 *
 * 参数 reg: 内部寄存器地址;  buf/len: 接收缓冲与长度
 * 返回值: 1=成功, 0=失败(超时/NACK/总线故障)
 * --------------------------------------------------------------------------- */
static uint8_t ds3231_i2c_read(uint8_t reg, uint8_t *buf, uint8_t len)
{
    if (HAL_I2C_Mem_Read(&hi2c1, DS3231_I2C_ADDR, reg,
                         I2C_MEMADD_SIZE_8BIT, buf, len,          /* 寄存器地址是 8 位 */
                         DS3231_I2C_TIMEOUT) != HAL_OK) {
        return 0;
    }
    return 1;
}

/* ---------------------------------------------------------------------------
 * I2C 写 DS3231 内部寄存器 (与上面对称)
 *
 * 时序: 起始 → 从机地址(写) → 寄存器地址 → 数据1..N → 停止
 * 注意 DS3231 支持"自动地址递增", 所以可以从 0x00 起连续写 7 个字节。
 * --------------------------------------------------------------------------- */
static uint8_t ds3231_i2c_write(uint8_t reg, uint8_t *buf, uint8_t len)
{
    if (HAL_I2C_Mem_Write(&hi2c1, DS3231_I2C_ADDR, reg,
                          I2C_MEMADD_SIZE_8BIT, buf, len,
                          DS3231_I2C_TIMEOUT) != HAL_OK) {
        return 0;
    }
    return 1;
}

/* ---------------------------------------------------------------------------
 * 把编译日期里的英文月份缩写转成月份数字
 *
 * 为什么需要它? 见 BSP_DS3231_Init: 当 RTC 时间明显不对(说明纽扣电池没电/
 * 芯片没设过时间)时, 用"固件编译时刻"当初始时间, 这样系统第一时间就有个
 * 大致靠谱的时间, 而不是 2000-01-01。
 *
 * 输入形如 "Jan"/"Feb"/.../"Dec" (来自编译器宏 __DATE__ 的前 3 个字符)。
 * 实现用首字母分派, 再靠第二/三个字母区分同首字母的月份:
 *   J 开头: Ja=n→1月(Jan)  否则 n→6月(Jun)  l→7月(Jul)
 *   M 开头: r→3月(Mar)     否则 5月(May)
 *   A 开头: p→4月(Apr)     否则 8月(Aug)
 * 其余首字母唯一, 直接返回。
 * --------------------------------------------------------------------------- */
static uint8_t parse_month(const char *s)
{
    if (s[0] == 'J') {
        if (s[1] == 'a') return 1;    /* Jan */
        if (s[2] == 'n') return 6;    /* Jun */
        return 7;                     /* Jul */
    }
    if (s[0] == 'F') return 2;        /* Feb */
    if (s[0] == 'M') {
        if (s[2] == 'r') return 3;    /* Mar */
        return 5;                     /* May */
    }
    if (s[0] == 'A') {
        if (s[1] == 'p') return 4;    /* Apr */
        return 8;                     /* Aug */
    }
    if (s[0] == 'S') return 9;        /* Sep */
    if (s[0] == 'O') return 10;       /* Oct */
    if (s[0] == 'N') return 11;       /* Nov */
    if (s[0] == 'D') return 12;       /* Dec */
    return 1;                         /* 兜底: 认不出来就当 1 月 */
}

/* ---------------------------------------------------------------------------
 * DS3231 初始化
 *
 * 三件事:
 *   1) 探活: 读一下秒寄存器, 读得到说明 I2C 通了 (这是判断"芯片在不在"的最快方法)
 *   2) 读当前时间并打印, 方便人工确认
 *   3) 时间校准: 如果年份 < 2024(dt.year < 24), 说明 RTC 里的时间是无效的
 *      (新芯片出厂/纽扣电池没电, 上电默认是 2000-01-01), 此时用"固件编译时刻"
 *      写入, 让系统有个合理的时间起点。
 *
 * 【为什么用 __DATE__ / __TIME__?】
 *   它们是 C 编译器内置宏, 分别展开成"编译这行代码时的日期"和"时间",
 *   格式固定:
 *     __DATE__ = "Sep 11 2026"  (月缩写占3字符, 日为空格补齐的宽2字符, 年4字符)
 *     __TIME__ = "22:58:24"     (时:分:秒, 各2位)
 *   所以可以直接按固定下标取字符再转数字, 例如 time_str[0..1] 就是小时。
 *   日期的"日"要当心: 1~9 号是 " 1" 这种形式(第 4 个字符是空格), 所以要判断
 *   date_str[4] == ' ' 来区分。
 *
 * 返回值: 1=成功, 0=失败
 * --------------------------------------------------------------------------- */
uint8_t BSP_DS3231_Init(void)
{
    uint8_t buf[1];    /* 读 1 字节用于探活 */

    printf("[DS3231] Init...\r\n");

    /* 1) 探活: 能读到秒寄存器说明芯片在线 */
    if (!ds3231_i2c_read(DS3231_REG_SECONDS, buf, 1)) {
        printf("[DS3231] I2C read failed!\r\n");
        return 0;
    }
    printf("[DS3231] Detected, seconds=0x%02X\r\n", buf[0]);   /* 打印原始 BCD 值 */

    /* 2) 读完整时间并打印 */
    DS3231_DateTime dt;
    if (!BSP_DS3231_GetTime(&dt)) {
        printf("[DS3231] Time read failed!\r\n");
        return 0;
    }
    printf("[DS3231] Current: %04d-%02d-%02d %02d:%02d:%02d\r\n",
           2000 + dt.year, dt.month, dt.date,
           dt.hour, dt.minute, dt.second);

    /* 3) 时间无效(year<24, 即早于 2024 年) → 用编译时间校准 */
    if (dt.year < 24) {
        const char *date_str = __DATE__;    /* 形如 "Sep 11 2026" */
        const char *time_str = __TIME__;    /* 形如 "22:58:24" */

        dt.month   = parse_month(date_str);                              /* "Sep" → 9 */
        /* "日": date_str[4] 可能是空格(1~9号), 则十位记 0 */
        dt.date    = (uint8_t)((date_str[4] == ' ' ? 0 : (date_str[4] - '0') * 10)
                              + (date_str[5] - '0'));
        /* "年": 取最后两位, 如 "2026" → 26 */
        dt.year    = (uint8_t)((date_str[9] - '0') * 10 + (date_str[10] - '0'));
        dt.hour    = (uint8_t)((time_str[0] - '0') * 10 + (time_str[1] - '0'));  /* 时 */
        dt.minute  = (uint8_t)((time_str[3] - '0') * 10 + (time_str[4] - '0'));  /* 分 */
        dt.second  = (uint8_t)((time_str[6] - '0') * 10 + (time_str[7] - '0'));  /* 秒 */
        dt.weekday = 1;

        if (BSP_DS3231_SetTime(&dt)) {
            printf("[DS3231] Calibrated: %04d-%02d-%02d %02d:%02d:%02d\r\n",
                   2000 + dt.year, dt.month, dt.date,
                   dt.hour, dt.minute, dt.second);
        } else {
            printf("[DS3231] Calibrate FAIL\r\n");
        }
    }

    printf("[DS3231] Init OK\r\n");
    return 1;
}

/* ---------------------------------------------------------------------------
 * 读当前日期时间
 *
 * 【为什么一次性读 7 个字节, 而不是分别读 7 次?】——
 *   时间寄存器会"自己走动"。如果分开读: 读到秒=59, 这时候芯片进位了,
 *   再读分 = 已经是 +1 之后的值, 结果拼出个不存在的时刻(比如 10:60:59)。
 *   一次 I2C 突发读(burst read)7 个字节是原子的, 芯片保证这 7 个字节是同一时刻的
 *   快照, 从根本上避免这种"跨进位误差"。
 *
 * 各字段的掩码含义:
 *   regs[0] & 0x7F  秒: BIT7 是 CH(时钟暂停)位, 不是数据, 要屏蔽
 *   regs[1] & 0x7F  分: BIT7 恒 0
 *   regs[2]         时: 见下面的 12/24 小时制处理
 *   regs[3] & 0x07  星期: 只用低 3 位
 *   regs[4] & 0x3F  日: 屏蔽 2 个世纪位
 *   regs[5] & 0x1F  月: 屏蔽 BIT7 世纪位
 *   regs[6]         年: 直接用
 *
 * 返回值: 1=成功, 0=失败
 * --------------------------------------------------------------------------- */
uint8_t BSP_DS3231_GetTime(DS3231_DateTime *dt)
{
    if (dt == NULL) return 0;

    uint8_t regs[7];    /* 一次读回 7 个寄存器: 00~06 */
    if (!ds3231_i2c_read(DS3231_REG_SECONDS, regs, 7)) {
        return 0;
    }

    dt->second  = bcd_to_bin(regs[0] & 0x7F);   /* 秒, 屏蔽 CH 位 */
    dt->minute  = bcd_to_bin(regs[1] & 0x7F);   /* 分 */

    /* 小时字段要区分 12 小时制 / 24 小时制:
     *   BIT6 = 1 → 12 小时制: BIT5 = 1 表示下午(PM), 低 5 位是 1~12 的 BCD 值
     *   BIT6 = 0 → 24 小时制: 低 6 位就是 0~23 的 BCD 值 (本驱动写时间时用的是这种)
     * 本项目写时间用 24 小时制, 但读的时候仍然兼容 12 小时制, 以防芯片被人设成 12 小时制。 */
    if (regs[2] & 0x40) {                                   /* BIT6=1: 12 小时制 */
        uint8_t pm = (regs[2] & 0x20) ? 1 : 0;               /* BIT5: 是否下午 */
        uint8_t hour12 = bcd_to_bin(regs[2] & 0x1F);         /* 取 1~12 */
        if (hour12 == 12) {
            dt->hour = pm ? 12 : 0;                          /* 12PM=12点, 12AM=0点(午夜) */
        } else {
            dt->hour = hour12 + pm * 12;                     /* 下午就加 12 小时 */
        }
    } else {                                                /* BIT6=0: 24 小时制 */
        dt->hour = bcd_to_bin(regs[2] & 0x3F);
    }

    dt->weekday = regs[3] & 0x07;                /* 星期 (低 3 位) */
    dt->date    = bcd_to_bin(regs[4] & 0x3F);    /* 日 */
    dt->month   = bcd_to_bin(regs[5] & 0x1F);    /* 月 */
    dt->year    = bcd_to_bin(regs[6]);           /* 年 (00~99) */

    return 1;
}

/* ---------------------------------------------------------------------------
 * 设置日期时间
 *
 * 先做参数合法性检查再写, 避免把非法值(如 25 点、13 月)写进芯片导致越走越乱。
 * 检查里 year 允许 0~99 (对应 2000~2099)。
 *
 * 写入的 7 个字节依次是 秒/分/时/星期/日/月/年。写完后芯片就按新时间走。
 * 【小知识】秒寄存器的 BIT7 是 CH 位: 置 1 会让时钟停振(省电/运输模式),
 *   写 0 才走时。这里 bin_to_bcd 的结果 BIT7 永远是 0, 所以顺便就把 CH 清了,
 *   等于"写时间即启动时钟"。
 *
 * 返回值: 1=成功, 0=参数非法或 I2C 写失败
 * --------------------------------------------------------------------------- */
uint8_t BSP_DS3231_SetTime(DS3231_DateTime *dt)
{
    if (dt == NULL) return 0;

    /* 范围检查: 先把明显非法的值挡掉 */
    if (dt->year > 99 || dt->month < 1 || dt->month > 12 ||
        dt->date < 1 || dt->date > 31 || dt->hour > 23 ||
        dt->minute > 59 || dt->second > 59) {
        return 0;
    }

    uint8_t regs[7];                              /* 待写入的 7 字节 */
    regs[0] = bin_to_bcd(dt->second);             /* 秒 */
    regs[1] = bin_to_bcd(dt->minute);             /* 分 */
    regs[2] = bin_to_bcd(dt->hour);               /* 时 (BIT6=0 → 24 小时制) */
    regs[3] = dt->weekday;                        /* 星期 (芯片自己算, 原样写) */
    regs[4] = bin_to_bcd(dt->date);               /* 日 */
    regs[5] = bin_to_bcd(dt->month);              /* 月 */
    regs[6] = bin_to_bcd(dt->year);               /* 年 */

    if (!ds3231_i2c_write(DS3231_REG_SECONDS, regs, 7)) {   /* 从 0x00 连续写 7 字节 */
        return 0;
    }

    return 1;
}

/* ---------------------------------------------------------------------------
 * 取当前 Unix 时间戳 (读 RTC → 换算)
 *
 * 日志模块用它给每条记录打时间戳。失败返回 0
 * (0 是 1970-01-01, 明显不可能是真实时间, 上层可用它判断"时间读取失败")。
 * --------------------------------------------------------------------------- */
uint32_t BSP_DS3231_GetUnixTimestamp(void)
{
    DS3231_DateTime dt;
    if (!BSP_DS3231_GetTime(&dt)) {
        return 0;                       /* 读取失败 */
    }
    return datetime_to_unix(&dt);       /* 换算成时间戳 */
}

/* ---------------------------------------------------------------------------
 * 用 Unix 时间戳设置 RTC
 *
 * 作用: 上位机可以通过命令下发"当前时间", 把网关的 RTC 校准成和服务器一致,
 *       避免网关自己的时钟慢慢跑偏。
 * 无返回值: 内部完成换算 + 下发; 失败静默(设置时间不是关键路径,
 *          失败了下一次历史时间戳只是不准, 不会影响系统运行)。
 * --------------------------------------------------------------------------- */
void BSP_DS3231_SetUnixTimestamp(uint32_t ts)
{
    DS3231_DateTime dt;
    unix_to_datetime(ts, &dt);          /* 时间戳 → 日期时间 */
    BSP_DS3231_SetTime(&dt);            /* 写入芯片 */
}

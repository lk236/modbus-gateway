/*
 * bsp_iwdg.c — 独立看门狗 (IWDG) 驱动
 * ============================================================================
 * 【看门狗是干什么的】
 *   嵌入式设备常年无人值守。如果程序因为电磁干扰跑飞、死循环、或者某个任务
 *   卡死, 设备就一直僵在那里不干活了。看门狗就是一个"硬件定时炸弹":
 *   你不按时来喂它, 它就把整个 MCU 复位, 让系统重新跑起来 —— 至少能自愈。
 *
 * 【IWDG 与 WWDG 的区别】
 *   - IWDG (Independent Watchdog): 时钟来自 LSI(内部低速 RC, ≈40kHz),
 *     独立于主时钟和外部晶振。就算主时钟挂了它还在跑, 所以最可靠。
 *     缺点: 精度差(L/SI 是 RC 振荡, 温漂大), 超时时间只能粗调。
 *   - WWDG (Window Watchdog): 时钟来自 PCLK1(主时钟), 精度高, 还能设"窗口"——
 *     喂太早也不行(说明程序跑太快, 也可能异常)。但主时钟挂了它就跟着歇菜。
 *   本项目用 IWDG: 工业网关最看重"可靠", 精度不重要。
 *
 * 【配置与超时计算】
 *   LSI ≈ 40kHz, 预分频 64 → IWDG 计数时钟 = 40000/64 = 625Hz (每格 1.6ms)
 *   重装载值 4000 格 → 超时 = 4000 / 625 = 6.4 秒
 *   所以"喂狗间隔必须 < 6.4 秒", 否则复位。
 *
 * 【三个密钥, 为什么要有密钥机制】
 *   IWDG 的几个寄存器不能用普通写方式操作, 必须先往 IWDG->KR 写固定密钥:
 *     0xCCCC = 启动看门狗(且不可再用软件关闭!)
 *     0x5555 = 解锁, 允许修改 PR(预分频)/RLR(重装载)寄存器
 *     0xAAAA = 喂狗(把计数器重装回 RLR 值)
 *   密钥机制的目的: 防止"程序跑飞后乱写寄存器"把看门狗意外喂掉或关掉 ——
 *   必须恰好写对密钥才生效, 概率极低。这是硬件的自我保护设计。
 *
 * 【本项目的用法】
 *   由 App 层的"看门狗监督任务"(WdgSupervisor) 统一喂狗。各个业务任务
 *   (Modbus/日志/健康检查) 定期上报自己的心跳, 监督任务检查每个心跳是否
 *   在超时窗口内; 全部正常才喂狗。这样"某一个任务卡死"也能被发现并复位,
 *   而不是简单地"主循环跑到就喂"。
 * ============================================================================
 */
#include "bsp_iwdg.h"
#include <stdio.h>

/* IWDG 寄存器操作密钥: 0x5555=解锁, 0xAAAA=喂狗, 0xCCCC=使能 */
#define IWDG_KEY_ENABLE     0xCCCC   /* 启动看门狗 */
#define IWDG_KEY_RELOAD     0xAAAA   /* 喂狗 */
#define IWDG_KEY_ACCESS     0x5555   /* 解锁配置寄存器 */

/* ---------------------------------------------------------------------------
 * 初始化并启动 IWDG
 *
 * 流程: 开 LSI 时钟并等它稳定 → 冻结调试 → 解锁 → 写预分频 → 写重装载
 *       → 先喂一次 → 启动
 *
 * 【每一步为什么这么做】
 *   1) LSI 是内部 RC 振荡器, 上电后需要几百微秒才能稳定。贸然启动 IWDG,
 *      时钟还没稳会导致超时时间不可预期。所以先开时钟、轮询 LSIRDY 标志。
 *   2) __HAL_DBGMCU_FREEZE_IWDG(): 让 CPU 被调试器暂停时, IWDG 计数也暂停。
 *      否则你单步调试时, 6.4 秒一到芯片就复位, 根本没法调。
 *      (只在调试模式下有效, 正式运行不影响)
 *   3) IWDG->SR 里的 PVU/RVU 是"更新中"标志: 写 PR/RLR 后硬件不是立即生效,
 *      要等这两位清零。所以每次写之前之后都要等, 否则新值会被丢弃。
 *   4) 先喂一次再启动: 启动瞬间计数器是从 RLR 满载开始的, 但保险起见喂一次,
 *      避免后续初始化代码耗时较长(超过 6.4s)直接复位。
 * --------------------------------------------------------------------------- */
void BSP_IWDG_Init(void)
{
    uint8_t pr = IWDG_PRESCALER_64;   /* 预分频 64: 40kHz/64 = 625Hz (每格 1.6ms) */
    uint16_t rlr = 4000;               /* 重装载值 4000: 4000/625 ≈ 6.4s */

    /* 1. 打开内部低速时钟 LSI 并等待它稳定 (启动 IWDG 的前提) */
    __HAL_RCC_LSI_ENABLE();
    {
        uint32_t timeout = 100000;    /* 超时计数, 防止 LSI 坏了死等在这里 */
        /* 轮询 LSI 就绪标志, 超时则放弃 (LSI 故障时) */
        while (!__HAL_RCC_GET_FLAG(RCC_FLAG_LSIRDY) && --timeout);
        if (timeout == 0) {
            printf("[IWDG] ERROR: LSI not ready!\r\n");
            return;                   /* LSI 都没起来, 只能放弃启动看门狗 */
        }
    }

    /* 2. 调试模式下冻结 IWDG: 断点停在调试器时喂狗计时也暂停, 方便单步调试 */
    __HAL_DBGMCU_FREEZE_IWDG();

    /* 3. 写预分频寄存器。PVU/RVU 是"写完成标志", 写配置前必须先等上一次写完成 */
    while (IWDG->SR & IWDG_SR_PVU);       /* 等之前的预分频写入完成 (PVU=0) */
    IWDG->KR = IWDG_KEY_ACCESS;           /* 解锁访问 (写 0x5555) */
    IWDG->PR = pr;                        /* 写预分频值 (立即锁回) */
    while (IWDG->SR & IWDG_SR_PVU);       /* 等本次预分频生效 */

    /* 4. 写重装载值 (同样要等 RVU 完成标志) */
    while (IWDG->SR & IWDG_SR_RVU);       /* 等上一次重装载写入完成 */
    IWDG->RLR = rlr;                      /* 写重装载值 4000 */
    while (IWDG->SR & IWDG_SR_RVU);       /* 等本次生效 */

    /* 5. 先喂一次狗(把计数重置满), 再使能看门狗。避免一使能很快就被复位 */
    IWDG->KR = IWDG_KEY_RELOAD;           /* 喂狗 0xAAAA */
    IWDG->KR = IWDG_KEY_ENABLE;           /* 使能 0xCCCC —— 从这一刻起炸弹开始倒计时 */

    printf("[IWDG] Init OK, prescaler=%d reload=%d timeout=%dms\r\n",
           pr, rlr, IWDG_TIMEOUT_MS);
}

/* ---------------------------------------------------------------------------
 * 喂狗: 把计数器重装回 4000
 *
 * 这行代码就是"我还活着"的信号。用一行就够, 因为它只是往密钥寄存器写 0xAAAA,
 * 硬件自动把 IWDG 计数器重置为 RLR 值。
 *
 * 由 App 的看门狗监督任务周期调用(项目里是每 1s 一次, 远小于 6.4s 窗口)。
 * --------------------------------------------------------------------------- */
void BSP_IWDG_Reload(void)
{
    IWDG->KR = IWDG_KEY_RELOAD;
}

/* ---------------------------------------------------------------------------
 * 检查"上次复位是不是看门狗造成的"
 *
 * 原理: 芯片复位原因会记录在 RCC 的复位标志寄存器里 (RCC_CSR 的 IWDGRSTF 位)。
 *   App 启动时调用它, 如果返回 1, 说明上次系统是"被看门狗踢复位"的,
 *   意味着上次运行出了问题(某任务卡死), 应该打日志/告警。
 *
 * 返回值: 1=上次是看门狗复位, 0=不是
 * --------------------------------------------------------------------------- */
uint8_t BSP_IWDG_IsResetByIWDG(void)
{
    if (__HAL_RCC_GET_FLAG(RCC_FLAG_IWDGRST)) {
        return 1;
    }
    return 0;
}

/* ---------------------------------------------------------------------------
 * 清除全部复位标志
 *
 * 【为什么必须清?】RCC 的复位标志是"粘滞"的 —— 一旦置位, 除非主动清除,
 *   否则下次开机还在。如果不清, 每次开机都会误报"上次是看门狗复位"。
 *   所以读完标志后要立刻清掉。
 * --------------------------------------------------------------------------- */
void BSP_IWDG_ClearResetFlag(void)
{
    __HAL_RCC_CLEAR_RESET_FLAGS();
}
